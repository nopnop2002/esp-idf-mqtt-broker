## main/Kconfig.projbuild
```kconfig
menu "Application Configuration"

	choice WIFI_MODE
		prompt "Wi-Fi Access mode"
		default ST_MODE
		help
			Select Wi-Fi Access mode.
		config ST_MODE
			bool "Station MODE"
			help
				Wi-Fi is Station Mode.
		config AP_MODE
			bool "Access Point MODE"
			help
				Wi-Fi is Access Point Mode.
	endchoice

	config ESP_WIFI_SSID
		string "WiFi SSID"
		default "myssid"
		help
			SSID (network name) for the example to connect to.

	config ESP_WIFI_PASSWORD
		string "WiFi Password"
		default "mypassword"
		help
			WiFi password (WPA or WPA2) for the example to use.

	config ESP_MAX_STA_CONN
		depends on AP_MODE
		int "Maximum STA connections"
		default 4
		help
			Max number of the STA connects to AP.

	config ESP_MAXIMUM_RETRY
		depends on ST_MODE
		int "Maximum number of retries"
		default 5
		help
			Set the Maximum retry to avoid station reconnecting to the AP unlimited when the AP is really inexistent.

	config MDNS_HOSTNAME
		depends on ST_MODE
		string "mDNS Hostname"
		default "esp32-broker"
		help
			mDNS Hostname for example to use

	config STATIC_IP
		depends on ST_MODE
		bool "Enable Static IP Address"
		default false
		help
			Enable Static IP Address.

	config STATIC_IP_ADDRESS
		depends on STATIC_IP
		string "Static IP Address"
		default "192.168.10.100"
		help
			Static IP Address for Station.

	config STATIC_GW_ADDRESS
		depends on STATIC_IP
		string "Static GW Address"
		default "192.168.10.1"
		help
			Static GW Address for Station.

	config STATIC_NM_ADDRESS
		depends on STATIC_IP
		string "Static Netmask"
		default "255.255.255.0"
		help
			Static Netmask for Station.

	config SUBSCRIBE
		bool "Start MQTT SUBSCRIBER"
		default false
		help
			Start MQTT SUBSCRIBER.

	config PUBLISH
		bool "Start MQTT PUBLISHER"
		default false
		help
			Start MQTT PUBLISHER.

endmenu
```

## test/sdkconfig.defaults
```kconfig
#
# Partition Table
#
CONFIG_PARTITION_TABLE_CUSTOM=y
CONFIG_PARTITION_TABLE_CUSTOM_FILENAME="partitions_example.csv"
CONFIG_PARTITION_TABLE_CUSTOM_APP_BIN_OFFSET=0x10000
CONFIG_PARTITION_TABLE_FILENAME="partitions_example.csv"
CONFIG_APP_OFFSET=0x10000

# Disable WatchDog
CONFIG_ESP_INT_WDT=n
CONFIG_INT_WDT=n
CONFIG_TASK_WDT=n
CONFIG_ESP_TASK_WDT_EN=n


#
# mDNS
#
CONFIG_MDNS_STRICT_MODE=y
```
